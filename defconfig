## defconfig
```kconfig
CONFIG_BOOTSPLASH_IMAGE=y
CONFIG_BOOTSPLASH_FILE="./bootsplash.jpg"
CONFIG_VENDOR_LENOVO=y
CONFIG_VGA_BIOS=y
CONFIG_VGA_BIOS_FILE="./vgabios.bin"
CONFIG_HAVE_IFD_BIN=y
CONFIG_BOARD_LENOVO_X201=y
CONFIG_VALIDATE_INTEL_DESCRIPTOR=y
# CONFIG_INTEL_CHIPSET_LOCKDOWN is not set
CONFIG_HAVE_ME_BIN=y
CONFIG_CHECK_ME=y
CONFIG_HAVE_GBE_BIN=y
CONFIG_COREINFO_SECONDARY_PAYLOAD=y
```
